## config/boards/shields/think_corney/Kconfig.defconfig
```kconfig
# The side with the PS2 Mouse / TP has to be the central half

if SHIELD_THINK_CORNEY_RIGHT

config ZMK_KEYBOARD_NAME
	default "ThinkCorney"

config ZMK_SPLIT_ROLE_CENTRAL
	default y

config ZMK_MOUSE
    bool "Enable ZMK mouse emulation"
    default y
	
config ZMK_MOUSE_TICK_DURATION
    int "Mouse tick duration in ms"
    default 1

endif



if SHIELD_THINK_CORNEY_LEFT || SHIELD_THINK_CORNEY_RIGHT

config ZMK_SPLIT
	default y

endif
 
```

## config/west.yml
```yaml
manifest:
  remotes:
    - name: zmkfirmware
      url-base: https://github.com/zmkfirmware
    - name: urob
      url-base: https://github.com/urob
    - name: PikakueNNZ
      url-base: https://github.com/PikakueNNZ
  projects:
    - name: zmk
      remote: PikakueNNZ
      revision: pr-testing/mouse_ps2_v2
      import: app/west.yml
  self:
    path: config
```
