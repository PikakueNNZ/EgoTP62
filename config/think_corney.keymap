/* source keypos definitions */
#include "zmk-nodefree-config/keypos_def/keypos_62keys.h"

#define KEYS_L LN0 LN1 LN2 LN3 LN4 LT0 LT1 LT2 LT3 LT4 LM0 LM1 LM2 LM3 LM4 LB0 LB1 LB2 LB3 LB4 LF0 LF1
#define KEYS_R RN0 RN1 RN2 RN3 RN4 RN5 RT0 RT1 RT2 RT3 RT4 RT5 RM0 RM1 RM2 RM3 RM4 RM5 RB0 RB1 RB2 RB3 RB4 RB5 RF0 RF1
#define KEYS_T LH4 LH3 LH2 LH1 LH0 RH0 RH1 RH2 RH3 RH4

/* Enable keymap features that require forks or modules */
// #define HAS_UROB

#define HAS_TRI_STATE
// #define HAS_CAPSLOCK

#define HAS_MOUSE_KEYS
#define HAS_MOUSE_TP
// #define HAS_MOUSE_TP_BADJEFF_INPUT_LISTENER

/* source the main keymap */
#include "base.keymap"
